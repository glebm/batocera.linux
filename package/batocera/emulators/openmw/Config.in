## package/batocera/emulators/openmw/Config.in
```kconfig
# OpenMW and dependencies
source "$BR2_EXTERNAL_BATOCERA_PATH/package/batocera/emulators/openmw/openmw/Config.in"

if BR2_PACKAGE_OPENMW
source "$BR2_EXTERNAL_BATOCERA_PATH/package/batocera/emulators/openmw/gl4es-openmw/Config.in"
endif
```

## package/batocera/emulators/openmw/mygui-openmw/Config.in
```kconfig
config BR2_PACKAGE_MYGUI_OPENMW
	# (hidden package) A version of MyGUI for the OpenMW Morrowind Engine
	bool "MyGUI UI toolkit for games and 3D applications"
	select BR2_PACKAGE_SDL2

	depends on BR2_INSTALL_LIBSTDCPP
	depends on BR2_PACKAGE_HAS_LIBGL || BR2_PACKAGE_HAS_LIBGLES
	help
	  MyGUI is a cross-platform library for creating graphical user interfaces (GUIs) for games and 3D applications.

	  https://github.com/MyGUI/mygui
```

## package/batocera/emulators/openmw/osg-openmw/Config.in
```kconfig
config BR2_PACKAGE_OSG_OPENMW
	# (hidden package) A version of OpenSceneGraph graphics toolit for the OpenMW Morrowind Engine
	bool
	select BR2_PACKAGE_FREETYPE
	select BR2_PACKAGE_GIFLIB
	select BR2_PACKAGE_JPEG
	select BR2_PACKAGE_LIBPNG
	select BR2_PACKAGE_OPENAL
	select BR2_PACKAGE_SDL2
	select BR2_PACKAGE_TIFF
	select BR2_PACKAGE_ZLIB

	select BR2_PACKAGE_GL4ES_OPENMW if !BR2_PACKAGE_HAS_LIBGL

	depends on BR2_INSTALL_LIBSTDCPP
	depends on BR2_PACKAGE_HAS_LIBGL || BR2_PACKAGE_HAS_LIBGLES
	help
	  The OpenSceneGraph is a graphics toolkit for the development of
	  graphic applications such as flight simulators, games, virtual
	  reality and scientific visualization. Based around the concept of a
	  scene graph, it provides an object-oriented framework on top of
	  OpenGL, freeing the developer from implementing and optimizing low
	  level graphics calls, and provides many additional utilities for
	  development of graphics applications.

	  http://www.openscenegraph.org/

if BR2_PACKAGE_OSG

config BR2_PACKAGE_OSG_JPEG2000
	bool "Enable JPEG-2000 support"

endif
```
